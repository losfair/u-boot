## board/bluelogic/magicore-dev/Kconfig
```kconfig
if TARGET_MAGICORE_DEV

config SYS_BOARD
	default "magicore-dev"

config SYS_VENDOR
	default "bluelogic"

config SYS_CPU
	default "generic"

config SYS_CONFIG_NAME
	default "magicore-dev"

config SYS_TEXT_BASE
	default 0x1c000000

config BOARD_SPECIFIC_OPTIONS # dummy
	def_bool y
	select GENERIC_RISCV
endif
```

## configs/magicore_dev_defconfig
```kconfig
CONFIG_RISCV=y
CONFIG_TARGET_MAGICORE_DEV=y
CONFIG_ARCH_RV64I=y
CONFIG_RISCV_MMODE=y
CONFIG_RISCV_ISA_C=n
CONFIG_RISCV_ISA_A=n
CONFIG_RISCV_TIMER=y
CONFIG_XIP=y # Get rid of amo* instructions during early init
CONFIG_SYS_LOAD_ADDR=0x1c000000
CONFIG_DISPLAY_CPUINFO=y
CONFIG_DISPLAY_BOARDINFO=y
CONFIG_EFI_LOADER=n
CONFIG_FIT=y
CONFIG_OF_SEPARATE=y
CONFIG_DEFAULT_DEVICE_TREE="magicore-dev"

CONFIG_VEXRISCV_SERIAL=y
CONFIG_DEBUG_UART=y
CONFIG_DEBUG_UART_VEXRISCV=y
CONFIG_DEBUG_UART_CLOCK=80000000
CONFIG_DEBUG_UART_BASE=0xff010000
CONFIG_BAUDRATE=115200
CONFIG_NR_DRAM_BANKS=1

CONFIG_XILINX_EMACLITE=y
```

## configs/maglev_arm_defconfig
```kconfig
CONFIG_ARM=y
CONFIG_ARM_SMCCC=y
CONFIG_ARCH_QEMU=y
CONFIG_SYS_MALLOC_LEN=0x400000
CONFIG_SYS_LOAD_ADDR=0x40200000
CONFIG_TEXT_BASE=0x00000000
CONFIG_NR_DRAM_BANKS=1
CONFIG_HAS_CUSTOM_SYS_INIT_SP_ADDR=y
CONFIG_CUSTOM_SYS_INIT_SP_ADDR=0x40200000
CONFIG_ENV_SIZE=0x40000
CONFIG_ENV_SECT_SIZE=0x40000
CONFIG_DEFAULT_DEVICE_TREE="qemu-arm"
CONFIG_TARGET_QEMU_ARM_32BIT=y
CONFIG_DEBUG_UART_BASE=0x9000000
CONFIG_DEBUG_UART_CLOCK=0
CONFIG_ARMV7_LPAE=y
CONFIG_PCI=y
CONFIG_DEBUG_UART=y
CONFIG_AHCI=y
CONFIG_FIT=y
CONFIG_FIT_SIGNATURE=y
CONFIG_FIT_VERBOSE=y
CONFIG_FIT_BEST_MATCH=y
CONFIG_BOOTSTD_FULL=y
CONFIG_BOOTSTD_DEFAULTS=y
CONFIG_LEGACY_IMAGE_FORMAT=y
CONFIG_USE_PREBOOT=y
# CONFIG_DISPLAY_CPUINFO is not set
# CONFIG_DISPLAY_BOARDINFO is not set
CONFIG_PCI_INIT_R=y
CONFIG_SYS_CBSIZE=512
CONFIG_SYS_PBSIZE=532
CONFIG_SYS_BOOTM_LEN=0x4000000
CONFIG_CMD_BOOTEFI_SELFTEST=y
CONFIG_CMD_NVEDIT_EFI=y
CONFIG_CMD_DFU=y
CONFIG_CMD_MTD=y
CONFIG_CMD_PCI=y
CONFIG_CMD_USB=y
CONFIG_CMD_TPM=y
CONFIG_CMD_MTDPARTS=y
CONFIG_SCSI_AHCI=y
CONFIG_AHCI_PCI=y
CONFIG_DFU_TFTP=y
CONFIG_DFU_MTD=y
CONFIG_DFU_RAM=y
CONFIG_MTD=y
CONFIG_DM_MTD=y
CONFIG_MTD_NOR_FLASH=y
CONFIG_FLASH_SHOW_PROGRESS=0
CONFIG_CFI_FLASH=y
CONFIG_CFI_FLASH_USE_WEAK_ACCESSORS=y
CONFIG_SYS_FLASH_USE_BUFFER_WRITE=y
CONFIG_FLASH_CFI_MTD=y
CONFIG_SYS_FLASH_CFI=y
CONFIG_SYS_MAX_FLASH_SECT=256
CONFIG_SYS_MAX_FLASH_BANKS=2
CONFIG_SYS_MAX_FLASH_BANKS_DETECT=y
CONFIG_E1000=y
CONFIG_NVME_PCI=y
CONFIG_PCIE_ECAM_GENERIC=y
CONFIG_SCSI=y
CONFIG_DM_SCSI=y
CONFIG_DEBUG_UART_PL011=y
CONFIG_DEBUG_UART_SHIFT=2
CONFIG_SYSRESET=y
CONFIG_SYSRESET_CMD_POWEROFF=y
CONFIG_SYSRESET_PSCI=y
CONFIG_TPM2_MMIO=y
CONFIG_USB=y
CONFIG_USB_EHCI_HCD=y
CONFIG_USB_EHCI_PCI=y
CONFIG_TPM=y

CONFIG_MXC_UART=y
# CONFIG_SYS_ARM_MMU is not set
CONFIG_SYS_ARM_CACHE_CP15=y
CONFIG_CMD_MMC=y
CONFIG_MMC=y
CONFIG_MMC_WRITE=y
CONFIG_DM_MMC=y
CONFIG_MMC_QUIRKS=y
CONFIG_SYS_MMC_MAX_BLK_COUNT=65535
CONFIG_MMC_HW_PARTITIONING=y
CONFIG_MMC_VERBOSE=y
CONFIG_FSL_ESDHC_IMX=y
CONFIG_FSL_USDHC=y

CONFIG_MAGLEV_PV=y
CONFIG_RGMII=y
CONFIG_MII=y
CONFIG_RMII=y
CONFIG_FEC_MXC=y
CONFIG_DM_ETH_PHY=y
CONFIG_PHY_ATHEROS=y
CONFIG_PHYLIB=y
CONFIG_CMD_MDIO=y
```
